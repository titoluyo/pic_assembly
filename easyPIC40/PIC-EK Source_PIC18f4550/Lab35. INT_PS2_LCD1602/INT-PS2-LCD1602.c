/********************************************************************************************************
*********************************************************************************************************
*
* Hardware Environment:	PIC-EK
* Build Environment   : MPLAB IDE or MPLAB X IDE + PICC18_v8.35
* Microcontroller     : PIC18F4550
* Version             : V1.0
* By                  : JEFF
* DATE				  : 20150320
*
*(c) Copyright 2010-2018, Logifind Tech CO.,LTD
*http://www.logifind.com
*All Rights Reserved
*
*********************************************************************************************************
********************************************************************************************************/
#include <pic18.h>        //head file

__CONFIG(1,HS) ;  //EXT 20MHz,No PLL
__CONFIG(2,WDTDIS) ;      //WDT OFF
__CONFIG(3,PBADDIS) ;     //PORTB<4:0> configured as digital I/O on RESET 
__CONFIG(4,LVPDIS&XINSTDIS) ;     //Low Voltage Programming Disabled ,Disable extended instruction set (Legacy mode)   

#define RS  RB5 //Data or Instrument Select
#define RW  RB4 //Write or Read
#define E   RB3 //6800 mode Enable single
#define Key_Data RB1
#define Key_CLK  RB0 
unsigned char IntNum; //times of int
unsigned char KeyV; //key value
unsigned char Key_UP=0, Shift = 0;//Key_UP-released，Shift-pressed
unsigned char keybuf;
unsigned char disbuf;//84

bit bf;  //if receive char
bit disbit;

//Configure 0x66 as backspace key
//Configure 0x5a as Enter key
const unsigned char UnShifted[59][2] = {
0x1C, 'a',
0x32, 'b',
0x21, 'c',
0x23, 'd',
0x24, 'e',
0x2B, 'f',
0x34, 'g',
0x33, 'h',
0x43, 'i',
0x3B, 'j',
0x42, 'k',
0x4B, 'l',
0x3A, 'm',
0x31, 'n',
0x44, 'o',
0x4D, 'p',
0x15, 'q',
0x2D, 'r',
0x1B, 's',
0x2C, 't',
0x3C, 'u',
0x2A, 'v',
0x1D, 'w',
0x22, 'x',
0x35, 'y',
0x1A, 'z',
0x45, '0',
0x16, '1',
0x1E, '2',
0x26, '3',
0x25, '4',
0x2E, '5',
0x36, '6',
0x3D, '7',
0x3E, '8',
0x46, '9',
0x0E, '`',
0x4E, '-',
0x55, '=',
0x5D, '\\',
0x29, ' ',
0x54, '[',
0x5B, ']',
0x4C, ';',
0x52, '\'',
0x41, ',',
0x49, '.',
0x4A, '/',
0x71, '.',
0x70, '0',
0x69, '1',
0x72, '2',
0x7A, '3',
0x6B, '4',
0x73, '5',
0x74, '6',
0x6C, '7',
0x75, '8',
0x7D, '9',
};

const unsigned char Shifted[59][2] = {
0x1C, 'A',
0x32, 'B',
0x21, 'C',
0x23, 'D',
0x24, 'E',
0x2B, 'F',
0x34, 'G',
0x33, 'H',
0x43, 'I',
0x3B, 'J',
0x42, 'K',
0x4B, 'L',
0x3A, 'M',
0x31, 'N',
0x44, 'O',
0x4D, 'P',
0x15, 'Q',
0x2D, 'R',
0x1B, 'S',
0x2C, 'T',
0x3C, 'U',
0x2A, 'V',
0x1D, 'W',
0x22, 'X',
0x35, 'Y',
0x1A, 'Z',
0x45, '0',
0x16, '1',
0x1E, '2',
0x26, '3',
0x25, '4',
0x2E, '5',
0x36, '6',
0x3D, '7',
0x3E, '8',
0x46, '9',
0x0E, '~',
0x4E, '_',
0x55, '+',
0x5D, '|',
0x29, ' ',
0x54, '{',
0x5B, '}',
0x4C, ':',
0x52, '"',
0x41, '<',
0x49, '>',
0x4A, '?',
0x71, '.',
0x70, '0',
0x69, '1',
0x72, '2',
0x7A, '3',
0x6B, '4',
0x73, '5',
0x74, '6',
0x6C, '7',
0x75, '8',
0x7D, '9',
};



//******************************************************************/
//6x8.h文件：
/*-----------------------------------------------
6 x 8 font
1 pixel space at left and bottom
index = ASCII - 32
-----------------------------------------------*/
const unsigned char  font6x8[][6] =
{
{ 0x00, 0x00, 0x00, 0x00, 0x00, 0x00 },// sp
{ 0x00, 0x00, 0x00, 0x2f, 0x00, 0x00 },// !
{ 0x00, 0x00, 0x07, 0x00, 0x07, 0x00 },// "
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{ 0x14, 0x14, 0x14, 0x14, 0x14, 0x14 }// horiz lines
}; 



void delay(unsigned int t)
{
	unsigned int i,j;
	for(i=0;i<t;i++)
	{
		for(j=0;j<10;j++);
	}
}



void lcd_wait_busy(void)
{  
	TRISD7=1;	   		   
   	RS=0;			   
   	RW=1;			   
   	E=1;				   
   	while(RD7==1);         
   	E=0;				   
   	TRISD7=0;			   
}


void lcd_write_com(unsigned char combuf)
{  
	RS=0;          	
   	RW=0;           	
   	PORTD=combuf;      	
   	E=1;	            
   	asm("NOP");         
   	E=0;	            
}


void lcd_write_com_busy(unsigned char combuf)
{  
	lcd_wait_busy();		
   	lcd_write_com(combuf); 	
}


void lcd_write_data(unsigned char databuf)
{  
	lcd_wait_busy();	
   	RS=1;          	
   	RW=0;           	
   	PORTD=databuf;      
   	E=1;	            
   	asm("NOP");
   	E=0;	            
}


void lcd_write_address(unsigned char x,unsigned char y)
{  
	x&=0x0f;			
   	y&=0x01;			
   	if(y==0x00)
      	lcd_write_com_busy(x|0x80);	   
   	else
      	lcd_write_com_busy((x+0x40)|0x80);	   
}


void lcdreset(void)
{  
	delay(150); 
	lcd_write_com(0x38);
   	delay(50); 
	lcd_write_com(0x38);
   	delay(50); 
	lcd_write_com(0x38);
   	lcd_write_com_busy(0x38);       
   	lcd_write_com_busy(0x08);		
   	lcd_write_com_busy(0x01);		
   	lcd_write_com_busy(0x06);		
   	lcd_write_com_busy(0x0c);		
}  	

	
void lcd_write_char(unsigned char x,unsigned char y,unsigned char buf)
{  		
	lcd_write_address(x,y); 				
   	lcd_write_data(buf);		    
} 



unsigned char  Decode(unsigned char ScanCode)


{
	unsigned char TempCyc; 
	unsigned char KeyChar=0;
	if (!Key_UP) 
	{
		switch (ScanCode)
  		{
  			case 0xF0 : 
         		Key_UP = 1;
      		break;

  			case 0x12 : 
      			Shift = 1;
         	break;

  			case 0x59 : 
         		Shift = 1;
            break;
			case 0x66:  			
			break;
  			default: 
         		if(!Shift) 
         		{
       				for (TempCyc = 0;(UnShifted[TempCyc][0]!=ScanCode)&&(TempCyc<59); TempCyc++); 
          			if (UnShifted[TempCyc][0] == ScanCode) 
					{
                    	KeyChar=UnShifted[TempCyc][1]; 	
						disbit=1;
						disbuf=KeyChar;						
					}	
         		} 
      			else 
          		{
         			for(TempCyc = 0; (Shifted[TempCyc][0]!=ScanCode)&&(TempCyc<59); TempCyc++); 
       				if (Shifted[TempCyc][0] == ScanCode) 
					{
                    	KeyChar=Shifted[TempCyc][1];
						disbit=1;
						disbuf=KeyChar;						
					}
       			}
      		break;
     	}
	}
	else
	{ 
		Key_UP = 0;
		switch (ScanCode) 
  		{
  			case 0x12 : 
      			Shift = 0;
         	break;
  			case 0x59 : 
      			Shift = 0;
         	break;
  		}
	}
	return KeyChar;
} 		  


void interrupt init1(void)
{
	if(INT0IF==1)          						
	{						
		if(IntNum==0) 
		{
			KeyV=0;      			
		}
		else if(IntNum<9)      	
		{ 
			KeyV=KeyV>>1; 			
			if (Key_Data==1) KeyV|=0x80; 
		}		
		IntNum++;		                 		
		if (IntNum > 10)                     
		{
			IntNum = 0; 					
			bf = 1; 						
			keybuf=KeyV;                   	
			KeyV=0;      			       
		}		    
	}		
	INT0IF=0;            						
}


void main(void)
{	
	OSCCON=0X00;    			
	PORTB=0X00;
	LATB=0X00;
	ADCON1=0X0f;            	
  	TRISB=0B11000111;   	
	TRISD=0B00000000;   	
	INT0IF=0;  	            
	INTEDG0=0;               
  	INT0IE=1;  	            
  	GIE=1;                  
    RBIE=0;
	lcdreset();	 			// reset 1602
  	while(1)
  	{
    	if (bf==1)                         //if receive code
		{				
			Decode(keybuf);                //if receive,decode
			bf=0;						   			
		} 
    	if(disbit)                          
		{
			disbit=0;					   	 	
			lcd_write_char(0,0,disbuf);		
		}   	
  	}
}
